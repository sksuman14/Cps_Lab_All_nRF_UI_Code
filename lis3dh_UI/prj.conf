## CMakeLists.txt
```
cmake_minimum_required(VERSION 3.20.0)
find_package(Zephyr REQUIRED HINTS $ENV{ZEPHYR_BASE})

project(LIS3DH)

target_sources(app PRIVATE src/main.c)
target_sources(app PRIVATE src/ui.c)
```

## prj.conf
```kconfig
# ==========================================
# Core System & Console
# ==========================================
CONFIG_PRINTK=y
CONFIG_STDOUT_CONSOLE=y
CONFIG_REBOOT=y


# ==========================================
# UI Module (UART) Requirements
# ==========================================
CONFIG_SERIAL=y
CONFIG_UART_ASYNC_API=y

# ==========================================
# C Library & Floating Point Support (CRITICAL)
# ==========================================
# Required for fflush(), atoi(), strstr(), and printf floats (%.3f)
CONFIG_NEWLIB_LIBC=y
CONFIG_CBPRINTF_FP_SUPPORT=y

# ==========================================
# Sensor Framework & Hardware
# ==========================================
CONFIG_I2C=y
CONFIG_SENSOR=y
CONFIG_GPIO=y

# Zephyr uses this single driver for both the LIS2DH and LIS3DH
CONFIG_LIS2DH=y
```

## src/main.c
```c
#include <zephyr/kernel.h>
#include <zephyr/device.h>
#include <zephyr/drivers/sensor.h>
#include <zephyr/sys/printk.h>       // Replaced stdio.h with native Zephyr logging

#include "ui.h"

// Fetch and display accelerometer data
static void fetch_and_display(const struct device *sensor)   // Function to read and print accelerometer values
{
    static unsigned int count = 0;   // Sample counter to count number of readings
    struct sensor_value accel[3];    // Array to store X, Y, and Z acceleration values
    uint32_t upTime = k_uptime_get_32(); // Get current system uptime in milliseconds

    if (sensor_sample_fetch(sensor) < 0)   // Fetch new data sample from the accelerometer
    { 
        printk("ERROR: Sample fetch failed\n");   // Print error if fetching fails
        return;                                   // Exit function if fetch fails
    }

    if (sensor_channel_get(sensor, SENSOR_CHAN_ACCEL_XYZ, accel) < 0)   // Retrieve XYZ acceleration values from sensor
    { 
        printk("ERROR: Channel get failed\n");     // Print error if data retrieval fails
        return;                                    // Exit function if channel read fails
    }

    // Display sample count, uptime, and XYZ acceleration values
    printk("x %.3f, y %.3f, z %.3f\n",     
           sensor_value_to_double(&accel[0]),    
           sensor_value_to_double(&accel[1]),    
           sensor_value_to_double(&accel[2]));   
}

int main(void)                                    
{
    if (ui_init() != 0) return -1;

    // Get sensor device binding.
    const struct device *sensor = DEVICE_DT_GET_ANY(st_lis2dh);   

    if (sensor == NULL) {                        
        printk("Could not get %s device\n", "st_lis3dh");   
        return -1;                                  
    }

    if (!device_is_ready(sensor))                 
    { 
        printk("Device %s is not ready\n", sensor->name);   
        return -1;                                  
    }

    while (1)                                    
    {                                   
        // Call function to fetch and print accelerometer data
        fetch_and_display(sensor);                
        
        // Get the updated delay interval from the UI
        int target_ms = ui_get_interval_ms();
        int elapsed_ms = 0;

        // Check for updates every 100ms while waiting for next reading
        while (elapsed_ms < target_ms) {
            if (ui_interval_changed()) {
                ui_clear_change_flag();
                break; // Restart loop with new interval immediately
            }
            k_msleep(100);
            elapsed_ms += 100;
        }
    }
    
    return 0;
}
```

## src/ui.c
```c
#include "ui.h"
#include <zephyr/kernel.h>
#include <zephyr/sys/printk.h>
#include <zephyr/sys/reboot.h>
#include <zephyr/drivers/uart.h>
#include <string.h>
#include <stdlib.h>
#include <ctype.h>

#define RX_BUF_SIZE     64
#define RX_TIMEOUT      25 
#define CMD_BUF_SIZE    256

static uint8_t rx_buf[RX_BUF_SIZE];
static char cmd_buf[CMD_BUF_SIZE];
static size_t cmd_len = 0;
static bool interval_updated = false;
static int interval_ms = 1000;

static const struct device *uart_dev = DEVICE_DT_GET(DT_CHOSEN(zephyr_console));

static void process_commands(void) {
    if (cmd_len == 0) return;

    // Ensure the string is null-terminated for string functions
    cmd_buf[cmd_len] = '\0';

    // 1. Check for Restart
    if (strstr(cmd_buf, "restartDevice")) {
        printk("Rebooting...\n");
        k_msleep(50);
        sys_reboot(SYS_REBOOT_COLD);
        return;
    }

    // 2. Check for Set Interval
    char *p = strstr(cmd_buf, "SET_INTERVAL:");
    if (p) {
        p += strlen("SET_INTERVAL:");

        // Skip non-digits (spaces, colons, etc.)
        while (*p != '\0' && !isdigit((unsigned char)*p)) {
            p++;
        }

        if (isdigit((unsigned char)*p)) {
            int value = atoi(p); // atoi reads all digits until a non-digit appears
            if (value > 0) {
                interval_ms = value * 1000;
                interval_updated = true;
                printk("Interval updated to %d seconds\n", value, interval_ms);
            }
        } else {
            printk("Invalid interval value\n");
        }
    }

    // Reset buffer for the next command
    cmd_len = 0;
    memset(cmd_buf, 0, sizeof(cmd_buf));
}

// --- UART Callback Logic ---
static void uart_cb(const struct device *dev, struct uart_event *evt, void *user_data) {
    switch (evt->type) {
    
    case UART_RX_RDY: {
        const uint8_t *data = &evt->data.rx.buf[evt->data.rx.offset];
        for (size_t i = 0; i < evt->data.rx.len; i++) {
            
            // If it's a newline, process IMMEDIATELY
            if (data[i] == '\r' || data[i] == '\n') {
                if (cmd_len > 0) {
                    process_commands(); 
                }
            } 
            // Add characters to buffer
            else if (cmd_len < CMD_BUF_SIZE - 1) {
                cmd_buf[cmd_len++] = data[i];
            }
        }
        
        /* * FIX FOR THE DELAY: 
         * If the user stops typing but didn't hit enter, 
         * we can choose to process after a small amount of data is received
         * to avoid the 10-second wait.
         */
        break;
    }

    case UART_RX_DISABLED:
        // Simply re-enable the receiver. 
        // We now wait strictly for the newline (\r or \n) in UART_RX_RDY to process commands.
        uart_rx_enable(dev, rx_buf, sizeof(rx_buf), 20); 
        break;

    default:
        break;
    }
}

int ui_init(void) {
    if (!device_is_ready(uart_dev)) return -1;
    uart_callback_set(uart_dev, uart_cb, NULL);
    return uart_rx_enable(uart_dev, rx_buf, sizeof(rx_buf), RX_TIMEOUT);
}

int ui_get_interval_ms(void) { return interval_ms; }
bool ui_interval_changed(void) { return interval_updated; }
void ui_clear_change_flag(void) { interval_updated = false; }
```
