## CMakeLists.txt
```
cmake_minimum_required(VERSION 3.20.0)
find_package(Zephyr REQUIRED HINTS $ENV{ZEPHYR_BASE})

project(sts30)

target_sources(app PRIVATE src/main.c)
target_sources(app PRIVATE src/ui.c)
```

## prj.conf
```kconfig
CONFIG_STDOUT_CONSOLE=y
CONFIG_SERIAL=y
CONFIG_UART_ASYNC_API=y
CONFIG_REBOOT=y

# Hardware
CONFIG_I2C=y

# Required for temperature decimals and UI strings
CONFIG_NEWLIB_LIBC=y
CONFIG_CBPRINTF_FP_SUPPORT=y
```

## src/main.c
```c
#include <zephyr/kernel.h>  // Core Zephyr kernel APIs (threads, sleep, timing)
#include <zephyr/device.h>  // Device driver model and device access APIs
#include <zephyr/devicetree.h>  // Devicetree macros and helpers
#include <zephyr/drivers/i2c.h> // I2C driver APIs
#include <zephyr/sys/printk.h>  // printk() for kernel-level logging
#include <stdio.h>

#include "ui.h"          // Custom UART-based UI interface

/* The I2C_NODE macro links directly to mysensor: mysensor@4a in your overlay! */
#define I2C_NODE DT_NODELABEL(mysensor)  

#define STS3X_MEASURE_CMD 0x240B    // Command to trigger a temperature measurement

static int sts3x_soft_reset(const struct i2c_dt_spec *i2c_spec) {
    uint8_t reset_command[2] = {0x30, 0xA2};// Soft reset command as per datasheet
    return i2c_write_dt(i2c_spec, reset_command, sizeof(reset_command)); // Send reset command over I2C
}

// Triggers a temperature measurement and converts raw data to degrees Celsius
static int measure_temperature(const struct i2c_dt_spec *i2c_spec, float *temperature) {
    uint8_t command[2] = {STS3X_MEASURE_CMD >> 8, STS3X_MEASURE_CMD & 0xFF};
    uint8_t temp_data[3];

    // Write measurement command and read back temperature data
    int ret = i2c_write_read_dt(i2c_spec, command, sizeof(command), temp_data, sizeof(temp_data));
    if (ret != 0) {
        return ret;
    }
    
    // Combine MSB and LSB to form raw temperature value
    uint16_t raw_temp = (temp_data[0] << 8) | temp_data[1];

     // Convert raw temperature to degrees Celsius (STS3x conversion formula)
    *temperature = -45.0 + 175.0 * ((float)raw_temp / 65535.0);

    return 0;
}

int main(void) {

    if (ui_init() != 0) return -1;   // UART UI START

    // Get I2C device specification (Bus + 0x4a Address) from Devicetree
    static const struct i2c_dt_spec dev_i2c = I2C_DT_SPEC_GET(I2C_NODE);

    // Check if the I2C bus is ready for communication
    if (!device_is_ready(dev_i2c.bus)) {
        printk("I2C bus %s not ready!\n", dev_i2c.bus->name);
        return -1;
    }
    
    // Perform soft reset of the temperature sensor
    int ret = sts3x_soft_reset(&dev_i2c);
    if (ret != 0) {
        printk("Soft reset failed! %d\n", ret);
        return -1;                  // Exit if reset fails
    }

    k_msleep(100);       // Wait for sensor to stabilize after reset

    float temperature = 0.0;  // Variable to store temperature value

    while (1) {
        // Read temperature from sensor
        ret = measure_temperature(&dev_i2c, &temperature);
        if (ret == 0) {
            printk("Temp: %.2f °C\n", temperature);//Print temperature value
        } else {
            printk("Error reading temperature\n");   // Print error message
        }

        // Get user-defined measurement interval from UART UI
        int target_ms = ui_get_interval_ms();
        int elapsed_ms = 0;

        // Check for updates every 100ms while waiting for next reading
        while (elapsed_ms < target_ms) {
            if (ui_interval_changed()) {
                ui_clear_change_flag();
                break; // Restart loop with new interval immediately
            }
            k_msleep(100);
            elapsed_ms += 100;
        }
    }
    
    return 0;
}
```

## src/ui.h
```c
#ifndef UI_H_
#define UI_H_

#include <zephyr/types.h>
#include <stdbool.h>

int ui_init(void);
int ui_get_interval_ms(void);
bool ui_interval_changed(void);
void ui_clear_change_flag(void);

#endif
```
